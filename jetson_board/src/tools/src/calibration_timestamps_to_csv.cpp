// This code was entirely generated by ChatGPT, I just copied it and changed some of the variable names.

// Includes
// General cpp libraries
#include <fstream>
#include <iostream>
#include <memory>

// ROS2 specific libraries
#include "rclcpp/rclcpp.hpp"
#include "rclcpp/serialization.hpp"
#include "rosbag2_cpp/reader.hpp"
#include "rosbag2_storage/storage_options.hpp"
#include "rosbag2_cpp/converter_options.hpp"

// CalibrationTimestamps.msg
#include "amz_vio_pipeline_msgs/msg/calibration_timestamps.hpp"

int main (int argc, char ** argv) {

    // Check that the number of arguments is correct
    if (argc != 3) {
        std::cerr << "Expected 3x arguments: ros2 run tool calibration_timestamps_to_csv <rosbag_path> <csv_file_path>" << std::endl;
        return 1;
    }

    // Get rosbag path and CSV file path
    const std::string bag_path = argv[1];
    const std::string csv_path = argv[2];

    // Open CSV file
    std::ofstream csv(csv_path);

    // Check that CSV file was opened
    if (!csv.is_open()) {
        std::cerr << "Failed to open CSV" << std::endl;
        return 1;
    }

    // Add headers to CSV file
    csv << "imu_timestamp, mcu_timestamp\n";

    // Open rosbag
    rosbag2_cpp::Reader reader;
    rosbag2_storage::StorageOptions storage_options;
    storage_options.uri = bag_path;
    storage_options.storage_id = "sqlite3";
    rosbag2_cpp::ConverterOptions converter_options;
    converter_options.input_serialization_format = "cdr";
    converter_options.output_serialization_format = "cdr";
    reader.open(storage_options, converter_options);

    // Serialization object
    rclcpp::Serialization<amz_vio_pipeline_msgs::msg::CalibrationTimestamps> serialization;

    while (reader.has_next()) {
        auto bag_msg = reader.read_next();

        // Ignore all topics except "calibration_timestamps"
        if (bag_msg->topic_name != "/calibration_timestamps") {
            continue;
        }

        // Deserialize
        rclcpp::SerializedMessage serialized_msg(*bag_msg->serialized_data);
        amz_vio_pipeline_msgs::msg::CalibrationTimestamps msg;

        serialization.deserialize_message(
            &serialized_msg,
            &msg);

        // Write to CSV
        csv << msg.imu_timestamp << "," << msg.mcu_timestamp << "\n";

    }

    // Close CSV
    csv.close();

    // Notify of completion
    std::cout << "Finished writing " << csv_path << "\n";

    return 0;

}